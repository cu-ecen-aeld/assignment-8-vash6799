## base_external/package/aesd-assignments/Config.in
```kconfig
config BR2_PACKAGE_AESD_ASSIGNMENTS
	bool "aesd-assignments"
	help
	  Includes the writer executable, finder.sh and tester.sh in the kernel image.
	  Used to understand buildroot external trees and package builds.
source "$BR2_EXTERNAL_project_base_PATH/package/aesd-char-driver/Config.in"
```

## base_external/package/aesd-char-driver/Config.in
```kconfig
config BR2_PACKAGE_AESD_CHAR_DRIVER
	bool "aesd-char-driver"
	depends on BR2_LINUX_KERNEL
	help
	  Includes the AESD character device driver kernel module
	  and the associated load/unload utility scripts.
```
